/ {
	scratch_mem@3e000000 {
		#address-cells = <1>;
		#size-cells = <1>;
		reg = <0x3e000000 0x2000000>;
		compatible = "generic-uio";
		interrupts = < 0 58 0 >; //< Needed for older versions of uio driver, it's fake, make sure doesn't clash with anything
		interrupt-parent = <0x1>;
	};
};

